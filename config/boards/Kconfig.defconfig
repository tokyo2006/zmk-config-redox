## config/boards/Kconfig.defconfig
```kconfig
# Copyright (c) 2020 The ZMK Contributors
# SPDX-License-Identifier: MIT

if SHIELD_REDOXDACTYL_LEFT

config ZMK_KEYBOARD_NAME
	default "Redox"

config ZMK_SPLIT_BLE_ROLE_CENTRAL
	default y

endif

if SHIELD_REDOXDACTYL_LEFT || SHIELD_REDOXDACTYL_RIGHT

config ZMK_SPLIT
	default y

endif
```

## config/boards/Kconfig.shield
```kconfig
# Copyright (c) 2020 The ZMK Contributors
# SPDX-License-Identifier: MIT

config SHIELD_REDOXDACTYL_LEFT
	def_bool $(shields_list_contains,redoxdactyl_left)

config SHIELD_REDOXDACTYL_RIGHT
	def_bool $(shields_list_contains,redoxdactyl_right)
```

## config/boards/shields/redox/Kconfig.shield
```kconfig
# Copyright (c) 2020 The ZMK Contributors
# SPDX-License-Identifier: MIT

config SHIELD_REDOX_CENTRAL_DONGLE
    def_bool $(shields_list_contains,redox_central_dongle)

config SHIELD_REDOX_CENTRAL_LEFT
    def_bool $(shields_list_contains,redox_central_left)
    
config SHIELD_REDOX_PERIPHERAL_LEFT
    def_bool $(shields_list_contains,redox_peripheral_left)

config SHIELD_REDOX_PERIPHERAL_RIGHT
    def_bool $(shields_list_contains,redox_peripheral_right)
```
